#include <stdio.h>
#include "sdkconfig.h"
#include "driver/gpio.h"
#include "esp_err.h"
#include "esp_log.h"
#include "LCD.h"

#define HIGH 1
#define LOW 0

void LCD_delay(volatile int time)  //简单软件延时
{
	volatile unsigned int i;	
	while(time--)
	for(i=500;i>0;i--);
}
void configure_LCD_GPIO(void)
{
    ESP_LOGI("example", "Tiky configure LCD special GPIO!");

	/* Set the GPIO as a push/pull output: CS + SCK + SDA */
	gpio_config_t bk_gpio_config = {
        .mode = GPIO_MODE_OUTPUT,
						//  CS           SCK        SDA
        .pin_bit_mask = (1ULL << 1)|(1ULL << 13)|(1ULL << 20)
    };
    ESP_ERROR_CHECK(gpio_config(&bk_gpio_config));

    gpio_set_level(13, HIGH);
    gpio_set_level(20, HIGH);
}

/* static void LCD_Reset(void)
{
	LCD_RST(0);
    LCD_delay(100);					   
    LCD_RST(1);		 	 
    LCD_delay(100);					   

} */
void LCD_WriteByteSPI(unsigned char byte)
{
    unsigned char n;
   
    for(n=0; n<8; n++)			
    {  
        if(byte&0x80) SPI_SDA(1)
        else SPI_SDA(0)
        
        SPI_DCLK(0);
		byte<<= 1;
        SPI_DCLK(1);
    }
}

void SPI_WriteComm(unsigned int CMD)//3线9bit 串行接口
{			
	LCD_SPI_CS(0);
	SPI_SDA(0);
	SPI_DCLK(0);
	SPI_DCLK(1);
	LCD_WriteByteSPI(CMD);
	LCD_SPI_CS(1);
}
void SPI_WriteData(unsigned int tem_data)
{			
	LCD_SPI_CS(0);
	SPI_SDA(1);
	SPI_DCLK(0);
	SPI_DCLK(1);
	LCD_WriteByteSPI(tem_data);
	LCD_SPI_CS(1);
}


#define REGFLAG_DELAY         0XFE
#define REGFLAG_END_OF_TABLE  0xFD   /* END OF REGISTERS MARKER */

struct LCM_setting_table {
	unsigned char cmd;
	unsigned int count;
	unsigned char para_list[64];
};

static struct LCM_setting_table lcm_initialization_setting[] = {
	//{0x11, 1, {0x00} },
	//{REGFLAG_DELAY, 60, {0x00} },
	{0x3A, 1, {0x70} },
	{0xff, 5, {0x77, 0x01, 0x00, 0x00, 0x10} },
	{0xc0, 2, {0x3B, 0x00} },
	{0xc1, 2, {0x06, 0x05} },
	{0xc2, 2, {0x37, 0x02} },
	{0xc6, 1, {0x21} },
	{0xcc, 1, {0x30} },
	//{0xcd, 1, {0x08} },

	{0xb0, 16, {0xC0, 0x54, 0x5C, 0x0D, 0x51, 0x06, 0x09, 0x08, 0x07,
		   0x24, 0x03, 0x11, 0x0F, 0xAC, 0xB5, 0x7F} },

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	{0xd0, 1, {0x88} },
	{REGFLAG_DELAY, 50, {0x00} },

	
	{0xe0, 5, {0x00,0x18,0x00,0x00,0x00,0x20} },
	{0xe1, 11, {0x02,0x00,0x04,0x00,0x01,0x00,0x03,0x00,0x00,0x22,0x22} },
	{0xe2, 13, {0x10,0x10,0x20,0x20,0xE7,0x00,0x00,0x00,0xE6,0x00,0x00,0x00,0x00} },
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	{0xe8, 16, {0x02,0xDF,0x00,0xF5,0x04,0xE1,0x00,0xF5,0x06,0xE3,0x00,0xF5,0x08,0xE5,0x00,0xF5} },
//	{0xEA, 16, {0x10, 0x00, 0x10, 0x00, 0x10, 0x00, 0x10, 0x00, 0x10, 0x00, 
//			0x10, 0x00, 0x10, 0x00, 0x10, 0x00} },
	{0xeb, 7, {0x00,0x02,0xE4,0xE4,0x88,0x00,0x10} },

	{0xec, 3, {0x3D, 0x02, 0x02} },
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	{0x11, 1, {0x00} },
	{REGFLAG_DELAY, 50, {0x00} },
	{0x20, 1, {0x00} },  /* INVOFF（如果 SPI 恢复则关闭反转）*/
	{0x36, 1, {0x00} },
	{0x29, 1, {0x00} },
	{REGFLAG_END_OF_TABLE, 0x00, {0x00} }
};

static void lcd_panel_init(void)
{
	unsigned int i = 0,j=0;

	for (i = 0;; i++) {
		if (lcm_initialization_setting[i].cmd == REGFLAG_END_OF_TABLE)
			break;
		else if (lcm_initialization_setting[i].cmd == REGFLAG_DELAY)
			LCD_delay(lcm_initialization_setting[i].count);
		else {
			//GP_COMMAD_PA(lcm_initialization_setting[i].count+1);
			SPI_WriteComm(lcm_initialization_setting[i].cmd);
			for(j=0;j<lcm_initialization_setting[i].count;j++)
			SPI_WriteData(lcm_initialization_setting[i].para_list[j]);
		}
	}

	
}
void Lcd_Initialize(void)	//LCD初始化函数
{
    configure_LCD_GPIO();

	LCD_SPI_CS(0);
	LCD_delay(20);
	LCD_SPI_CS(1);
	LCD_delay(10);

    /* ── 软件复位 ST7701S ──
     * GPIO46 在 TK021F2699 上是 RGB VSYNC 而非 LCD RST 脚，
     * 无法用硬件复位。改用 SPI 软件复位命令 (0x01) 强制重置面板。
     * 排线重插后 POR 不可靠时，面板可能停在 Display Inversion ON
     * 的异常状态，表现为底片反相效果。软件复位可恢复默认配置。 */
    SPI_WriteComm(0x01);   /* Software Reset */
    LCD_delay(150);        /* ST7701S datasheet: 等待 ≥120ms */
    SPI_WriteComm(0x11);   /* Sleep Out */
    LCD_delay(120);        /* 等待 ≥50ms，留余量 */

 	lcd_panel_init();

    /* 释放 SPI 引脚，交由 RGB 面板驱动接管 */
    gpio_reset_pin(1);   // CS
    gpio_reset_pin(13);  // SCL
    gpio_reset_pin(20);  // SDA
}
