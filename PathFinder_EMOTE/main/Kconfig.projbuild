## PathFinder_EMOTE/main/Kconfig.projbuild
```kconfig
menu "Example Configuration"
    config EXAMPLE_DOUBLE_FB
        bool "Use double Frame Buffer"
        default "n"
        help
            Enable this option, driver will allocate two frame buffers.

    config EXAMPLE_USE_BOUNCE_BUFFER
        depends on !EXAMPLE_DOUBLE_FB
        bool "Use bounce buffer"
        help
            Enable bounce buffer mode can achieve higher PCLK frequency at the cost of higher CPU consumption.

    config EXAMPLE_AVOID_TEAR_EFFECT_WITH_SEM
        depends on !EXAMPLE_DOUBLE_FB
        bool "Avoid tearing effect"
        default "y"
        help
            Enable this option, the example will use a pair of semaphores to avoid the tearing effect.
            Note, if the Double Frame Buffer is used, then we can also avoid the tearing effect without the lock.

    config HMC5883L_ENABLE
        bool "Enable HMC5883L standalone magnetometer"
        default y
        help
            启用 HMC5883L 独立磁力计驱动（作为主罗盘数据源）。
            未挂载模块时，I2C 读取 timeout 会与 RGB LCD DMA 干扰，
            确认模块已接入 GPIO12(SCL)/GPIO14(SDA) 后开启。

    config SENSOR_I2C_SCAN_DEBUG
        bool "Enable I2C bus scan debug"
        default y
        help
            启动时扫描 I2C-1 总线并打印所有应答设备地址。
            注意：i2c_master_probe 在 ESP32-S3 上与 RGB LCD DMA 存在耦合干扰，
            调试完成后应关闭。
endmenu
```

## PathFinder_EMOTE/sdkconfig.defaults
```kconfig
# PSRAM: Octal 模式 80MHz
CONFIG_SPIRAM=y
CONFIG_SPIRAM_MODE_OCT=y
CONFIG_SPIRAM_SPEED_80M=y
# 允许 Wi-Fi/LWIP 在内部 RAM 不足时从 PSRAM 分配
# （否则 BLE+LCD framebuffer+LVGL 占用尽内部 RAM 时 esp_wifi_init 会 NO_MEM）
CONFIG_SPIRAM_TRY_ALLOCATE_WIFI_LWIP=y
# 降低 ALWAYSINTERNAL 阈值：让小于 4KB 的分配也可走 PSRAM
# 默认 16KB 太高，Wi-Fi pp wdev funcs 等小结构被强制走内部 RAM 导致 OOM
CONFIG_SPIRAM_MALLOC_ALWAYSINTERNAL=4096

# Wi-Fi buffer 最小化 — 释放内部 RAM 给 esf_buf_setup_static 使用
# 默认 static_rx=10 + dynamic_rx=32 + dynamic_tx=32 太多，与 LCD framebuffer 冲突
CONFIG_ESP_WIFI_STATIC_RX_BUFFER_NUM=4
CONFIG_ESP_WIFI_RX_BA_WIN=4
CONFIG_ESP_WIFI_DYNAMIC_RX_BUFFER_NUM=8
CONFIG_ESP_WIFI_DYNAMIC_TX_BUFFER_NUM=8
CONFIG_ESP_WIFI_TX_BA_WIN=4
CONFIG_ESP_WIFI_AMPDU_TX_ENABLED=n
CONFIG_ESP_WIFI_AMPDU_RX_ENABLED=n
CONFIG_ESP_WIFI_STATIC_RX_MGMT_BUFFER=n
CONFIG_ESP_WIFI_DYNAMIC_RX_MGMT_BUFFER=y
CONFIG_ESP_WIFI_DYNAMIC_RX_MGMT_BUF=1
CONFIG_ESP_WIFI_RX_MGMT_BUF_NUM_DEF=2
# 禁用 XIP — 避免 CPU 指令/数据争抢 PSRAM 带宽
# CONFIG_SPIRAM_FETCH_INSTRUCTIONS is not set
# CONFIG_SPIRAM_RODATA is not set

# CPU 240MHz — 提升 PSRAM 带宽余量，支撑 13MHz PCLK
CONFIG_ESP_DEFAULT_CPU_FREQ_MHZ_240=y

# RGB LCD — Bounce Buffer 模式（GDMA 从内部 SRAM 读取）
CONFIG_EXAMPLE_USE_BOUNCE_BUFFER=y

# 数据缓存行提升至 64B（减少 PSRAM 总线事务次数，优化带宽）
CONFIG_ESP32S3_DATA_CACHE_LINE_64B=y

# FreeRTOS 1000Hz（提升 LVGL 定时器精度，适配 VSYNC 同步）
CONFIG_FREERTOS_HZ=1000

# 恢复 USB-Serial-JTAG 二级控制台（保持与旧固件一致）
# 本板使用 CH340 USB-UART 桥，非 ESP32-S3 原生 USB-JTAG
# 此配置不影响 CH340 通信，仅控制原生 USB-JTAG 的 console 路由
CONFIG_ESP_CONSOLE_SECONDARY_USB_SERIAL_JTAG=y

# RGB LCD 稳定性增强
# 注意：ISR_IRAM_SAFE 会导致 spi_flash_read 期间 cache error 崩溃（ISR 访问 PSRAM 需 cache）
# 注意：RESTART_IN_VSYNC 会在 DMA under-run 时重启 DMA，导致画面整体跳动/闪屏
# CONFIG_LCD_RGB_ISR_IRAM_SAFE is not set
# CONFIG_LCD_RGB_RESTART_IN_VSYNC is not set

# Flash 16MB
CONFIG_ESPTOOLPY_FLASHSIZE_16MB=y
CONFIG_ESPTOOLPY_FLASHMODE_DIO=y
CONFIG_ESPTOOLPY_FLASHFREQ_80M=y

# 自定义分区表
CONFIG_PARTITION_TABLE_CUSTOM=y
CONFIG_PARTITION_TABLE_CUSTOM_FILENAME="partitions.csv"

# LVGL 8.x
CONFIG_LV_COLOR_DEPTH_16=y
CONFIG_LV_COLOR_16_SWAP=y
CONFIG_LV_USE_PERF_MONITOR=n
CONFIG_LV_DISP_DEF_REFR_PERIOD=15
CONFIG_LV_SHADOW_CACHE_SIZE=32
CONFIG_LV_CIRCLE_CACHE_SIZE=32

# LVGL 字体
CONFIG_LV_FONT_MONTSERRAT_8=y
CONFIG_LV_FONT_MONTSERRAT_14=y
CONFIG_LV_FONT_MONTSERRAT_16=y
CONFIG_LV_FONT_MONTSERRAT_18=y
CONFIG_LV_FONT_MONTSERRAT_20=y
CONFIG_LV_FONT_MONTSERRAT_24=y
# SimSun 16px CJK 字体（1000最常用中文字符，用于字幕显示）
CONFIG_LV_FONT_SIMSUN_16_CJK=y

# LVGL 控件
CONFIG_LV_USE_LABEL=y
CONFIG_LV_USE_BTN=y
CONFIG_LV_USE_IMG=y
CONFIG_LV_MEM_CUSTOM=y
CONFIG_LV_MEMCPY_MEMSET_STD=y
CONFIG_LV_USE_USER_DATA=y

# EAF 表情动画
CONFIG_LV_USE_IMG_TRANSFORM=y
CONFIG_LV_FONT_FMT_TXT_LARGE=y

# esp_mmap_assets
CONFIG_MMAP_FILE_NAME_LENGTH=32

# ADC 驱动 (UV 传感器)
# ESP-IDF 6.0 自动包含 esp_adc 组件

# BLE NimBLE
CONFIG_BT_ENABLED=y
CONFIG_BT_NIMBLE_ENABLED=y
CONFIG_BT_NIMBLE_HOST_TASK_STACK_SIZE=4096
CONFIG_BT_NIMBLE_MAX_CONNECTIONS=1
CONFIG_BT_NIMBLE_MAX_BONDS=0
CONFIG_BT_NIMBLE_ROLE_PERIPHERAL=y
CONFIG_BT_NIMBLE_ROLE_BROADCASTER=y
CONFIG_BT_NIMBLE_ROLE_CENTRAL=n
CONFIG_BT_NIMBLE_ROLE_OBSERVER=n
CONFIG_BT_NIMBLE_NVS_PERSIST=n
CONFIG_BT_NIMBLE_SM_LEGACY=n
CONFIG_BT_NIMBLE_SM_SC=n

# Wi-Fi
CONFIG_ESP_WIFI_ENABLED=y
CONFIG_ESP_WIFI_NVS_ENABLED=y
CONFIG_ESP_WIFI_SOFTAP_SUPPORT=y

# ESP-WIFI-MESH (A板为根节点)
CONFIG_MESH_ENABLED=y

# ESP-NOW (与 Mesh 共存，实时追踪数据)
CONFIG_ESP_WIFI_ESPNOW_MAX_ENCRYPT_NUM=1

# LWIP（根节点需要访问外网）
CONFIG_LWIP_MAX_SOCKETS=10

# HTTP Server (用于 Web Portal)
CONFIG_HTTPD_MAX_REQ_HDR_LEN=2048
CONFIG_HTTPD_MAX_URI_LEN=1024

# === 传感器模块 ===
# 启用 HMC5883L 独立磁力计驱动（作为主罗盘数据源）
CONFIG_HMC5883L_ENABLE=y
# 启用 I2C 总线扫描调试（诊断设备识别）
CONFIG_SENSOR_I2C_SCAN_DEBUG=y
```

## PathFinder_Tracker/sdkconfig.defaults
```kconfig
# ESP32-S3 N16R8 配置
# PSRAM: Octal 模式 80MHz
CONFIG_SPIRAM=y
CONFIG_SPIRAM_MODE_OCT=y
CONFIG_SPIRAM_SPEED_80M=y
CONFIG_SPIRAM_FETCH_INSTRUCTIONS=y
CONFIG_SPIRAM_RODATA=y
CONFIG_SPIRAM_TRY_ALLOCATE_WIFI_LWIP=y

# CPU 240MHz 双核
CONFIG_ESP_DEFAULT_CPU_FREQ_MHZ_240=y

# Flash 16MB
CONFIG_ESPTOOLPY_FLASHSIZE_16MB=y
CONFIG_ESPTOOLPY_FLASHSIZE="16MB"

# 分区表
CONFIG_PARTITION_TABLE_CUSTOM=y
CONFIG_PARTITION_TABLE_CUSTOM_FILENAME="partitions.csv"

# FreeRTOS
CONFIG_FREERTOS_HZ=1000

# Wi-Fi（Mesh 组网 + xiaozhi AI）
CONFIG_ESP_WIFI_ENABLED=y
CONFIG_ESP_WIFI_NVS_ENABLED=y
CONFIG_ESP_WIFI_SOFTAP_SUPPORT=y

# ESP-WIFI-MESH
CONFIG_MESH_ENABLED=y

# ESP-NOW（与 Mesh 共存）
CONFIG_ESP_WIFI_ESPNOW_MAX_ENCRYPT_NUM=1

# LWIP（子节点也需初始化）
CONFIG_LWIP_MAX_SOCKETS=4

# 控制台输出通过 UART0 (GPIO43/44, CH340 USB-Serial)
CONFIG_ESP_CONSOLE_UART=y
CONFIG_ESP_CONSOLE_UART_NUM=0
CONFIG_ESP_CONSOLE_SECONDARY_USB_SERIAL_JTAG=n

# 编译优化
CONFIG_COMPILER_OPTIMIZATION_SIZE=y
```
