#include <stdio.h>
#include "sdkconfig.h"
#include "driver/gpio.h"
#include "esp_err.h"
#include "esp_log.h"
#include "LCD.h"

#define HIGH 1
#define LOW 0




void LCD_delay(volatile int time)  //简单软件延时
{
	volatile unsigned int i;	
	while(time--)
	for(i=500;i>0;i--);
}
void configure_LCD_GPIO(void)
{
    ESP_LOGI("example", "Tiky configure LCD special GPIO!");

	/* Set the GPIO as a push/pull output */
	gpio_config_t bk_gpio_config = {
        .mode = GPIO_MODE_OUTPUT,
						//  CS           SCK        SDA
        .pin_bit_mask = (1ULL << 1)|(1ULL << 13)|(1ULL << 20)
    };
    ESP_ERROR_CHECK(gpio_config(&bk_gpio_config));
    

	//gpio_set_direction(46 , GPIO_MODE_OUTPUT);//RESET

    gpio_set_level(13, HIGH);
    gpio_set_level(20, HIGH);
/*
  	gpio_set_level(46, LOW);//RESET
    LCD_delay(500);
    gpio_set_level(46, HIGH);
    LCD_delay(100);
*/	
}

/* static void LCD_Reset(void)
{
	//注意，现在科学发达，有的屏不用复位也行 ，有的屏用硬件复位也不用RESET
	LCD_RST(0);
    LCD_delay(100);					   
    LCD_RST(1);		 	 
    LCD_delay(100);					   

} */
void LCD_WriteByteSPI(unsigned char byte)
{
    unsigned char n;
   
    for(n=0; n<8; n++)			
    {  
        if(byte&0x80) SPI_SDA(1)
        else SPI_SDA(0)
        
        SPI_DCLK(0);
		byte<<= 1;
        SPI_DCLK(1);
    }
}

void SPI_WriteComm(unsigned int CMD)//3线9bit 串行接口
{			
	LCD_SPI_CS(0);
	SPI_SDA(0);
	SPI_DCLK(0);
	SPI_DCLK(1);
	LCD_WriteByteSPI(CMD);
	LCD_SPI_CS(1);
}
void SPI_WriteData(unsigned int tem_data)
{			
	LCD_SPI_CS(0);
	SPI_SDA(1);
	SPI_DCLK(0);
	SPI_DCLK(1);
	LCD_WriteByteSPI(tem_data);
	LCD_SPI_CS(1);
}


#define REGFLAG_DELAY         0XFE
#define REGFLAG_END_OF_TABLE  0xFD   /* END OF REGISTERS MARKER */

struct LCM_setting_table {
	unsigned char cmd;
	unsigned int count;
	unsigned char para_list[64];
};

static struct LCM_setting_table lcm_initialization_setting[] = {
	//{0x11, 1, {0x00} },
	//{REGFLAG_DELAY, 60, {0x00} },
	{0x3A, 1, {0x70} },
	{0xff, 5, {0x77, 0x01, 0x00, 0x00, 0x10} },
	{0xc0, 2, {0x3B, 0x00} },
	{0xc1, 2, {0x06, 0x05} },
	{0xc2, 2, {0x37, 0x02} },
	{0xc6, 1, {0x21} },
	{0xcc, 1, {0x30} },
	//{0xcd, 1, {0x08} },

	{0xb0, 16, {0xC0, 0x54, 0x5C, 0x0D, 0x51, 0x06, 0x09, 0x08, 0x07,
		   0x24, 0x03, 0x11, 0x0F, 0xAC, 0xB5, 0x7F} },

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	{0xd0, 1, {0x88} },
	{REGFLAG_DELAY, 50, {0x00} },

	
	{0xe0, 5, {0x00,0x18,0x00,0x00,0x00,0x20} },
	{0xe1, 11, {0x02,0x00,0x04,0x00,0x01,0x00,0x03,0x00,0x00,0x22,0x22} },
	{0xe2, 13, {0x10,0x10,0x20,0x20,0xE7,0x00,0x00,0x00,0xE6,0x00,0x00,0x00,0x00} },
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	{0xe8, 16, {0x02,0xDF,0x00,0xF5,0x04,0xE1,0x00,0xF5,0x06,0xE3,0x00,0xF5,0x08,0xE5,0x00,0xF5} },
//	{0xEA, 16, {0x10, 0x00, 0x10, 0x00, 0x10, 0x00, 0x10, 0x00, 0x10, 0x00, 
//			0x10, 0x00, 0x10, 0x00, 0x10, 0x00} },
	{0xeb, 7, {0x00,0x02,0xE4,0xE4,0x88,0x00,0x10} },

	{0xec, 3, {0x3D, 0x02, 0x02} },
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	{0x11, 1, {0x00} },
	{REGFLAG_DELAY, 50, {0x00} },
	{0x20, 1, {0x00} },
	{0x36, 1, {0x00} },
	{0x29, 1, {0x00} },
	{REGFLAG_END_OF_TABLE, 0x00, {0x00} }
};
//static struct LCM_setting_table lcm_initialization_setting[] = {
//{0x11,0x01,{0x00}},
//{REGFLAG_DELAY, 150, {0x00}},
//{0xF0,0x02,{0x5A,0x5A}},
//{0xF1,0x02,{0x5A,0x5A}},
//{0xFC,0x02,{0x5A,0x5A}},
//{0xF8,0x26,{0x36,0x1B,0x00,0x00,0x00,0x82,0x00,0x1F,0x74,0x07,0x12,0x4F,0x3A,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0xD3,0x01}},
//{0xFF,0x03,{0x10,0x00,0x00}},
//{0xF2,0x03,{0x5A,0x03,0x0D}},
//{0xFA,0x19,{0x01,0x5A,0x44,0x66,0xAD,0xBF,0x9B,0xAF,0xBB,0xA3,0xC1,0xC9,0xBA,0x97,0xA2,0x8D,0xB2,0xB9,0xAD,0x00,0xBC,0x00,0xB3,0x00,0xC3}},
//{0xF7,0x02,{0x03,0x00}},
//{0xF6,0x03,{0x00,0x02,0x00}},
//{0xB6,0x09,{0x0C,0x02,0x03,0x32,0xC0,0x44,0x44,0xC0,0x00}},
//{0xF4,0x07,{0xCF,0x0A,0x15,0x10,0x19,0x33,0x02}},
////{0xD9,15,{0x14, 0x40, 0x0c, 0xcb, 0xce, 0x6e, 0xc4, 0x07,0x40, 0x41, 0xc1, 0x00, 0x60, 0x19}},
//{0xD9,11,{0x14, 0x40, 0x0C, 0xCB, 0xCE, 0x6E, 0xC4, 0x07,0xC0, 0x41,0x01}},
//{0xC0,0x01,{0x01}},
//{0xC1,0x1C,{0x47,0x53,0x13,0x53,0x00,0x00,0x02,0x57,0x00,0x00,0x03,0xFF,0x00,0x02,0x06,0x07,0x0A,0x0E,0x10,0x13,0x16,0x1A,0x1D,0x20,0x23,0x27,0x2A,0x2D}},

//{0x29,0x01,{0x00}},
//{REGFLAG_DELAY, 50, {0x00}},

//{REGFLAG_END_OF_TABLE, 0x00, {0x00} }
//};

static void lcd_panel_init(void)
{
	unsigned int i = 0,j=0;

	for (i = 0;; i++) {
		if (lcm_initialization_setting[i].cmd == REGFLAG_END_OF_TABLE)
			break;
		else if (lcm_initialization_setting[i].cmd == REGFLAG_DELAY)
			LCD_delay(lcm_initialization_setting[i].count);
		else {
			//GP_COMMAD_PA(lcm_initialization_setting[i].count+1);
			SPI_WriteComm(lcm_initialization_setting[i].cmd);
			for(j=0;j<lcm_initialization_setting[i].count;j++)
			SPI_WriteData(lcm_initialization_setting[i].para_list[j]);
		}
	}

	
}
void Lcd_Initialize(void)	//LCD初始化函数
{
    configure_LCD_GPIO();
	LCD_SPI_CS(0);
	LCD_delay(20);
	LCD_SPI_CS(1);
	//LCD_Reset();
	
	


 lcd_panel_init();


}